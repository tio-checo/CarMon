/*********************************************************************
 *
 * Provides API and services for BTM-112 Bluetooth module.
 *
 * Format of 'result' code generated by the module in response
 * to the completion of a command or when an event occurs:
 *
 * <LF>msg<LF>
 *
 * Example: <LF>CONNECT<SPACE><SPACE>'0012-6F-2388E8'<LF>
 *
 *********************************************************************/

#include "GenericTypeDefs.h"
#include "HardwareProfile/HardwareProfile.h"
#include "peripheral/uart.h"
#include "xc.h"
#include "bt.h"
#include "mon.h"
#include "master_comm.h"
#include "rt_light.h"

#include <errno.h>
#include <stdlib.h>
#include <stdio.h>
#include <string.h>

/* Receive state machine states */
#define BT_ST_RX_IDLE		0	/* machine is IDLE */
#define BT_ST_RX_MSG_SOF1	1	/* wait for message from the module */
#define BT_ST_RX_MSG_SOF2	2
#define BT_ST_RX_MSG_PAYLOAD	3

/* Transmit state machine states */
#define BT_ST_TX_IDLE		0	/* machine is IDLE */
#define BT_ST_TX_SEND		1	/* transmit character */

/* 'connect' message */
#define	BT_MSG_CONNECT		"CONNECT  '"
/* 'disconnect' message */
#define	BT_MSG_DISCONNECT	"DISCONNECT  '"
/* MAC address of GPS module */
#define	BT_GPS_MAC	"0012-6F-2249A9"

/* local variables */
/* TRUE if module is suspended; FALSE otherwise. */
static BOOL bt_is_suspended;
/* state of receive state machine */
static int bt_st_rx;
/* TRUE indicates that BT module is connected */
static BOOL bt_paired;
/* TRUE indicates that BT module is connected to GPS */
static BOOL bt_paired_with_gps;

/* local functions */

/*
 * Service function handling received characters.
 */
static void
bt_rx_svc(unsigned char ch)
{
	static char msg[50];

	/*
	 * Also process the received character, since it may be
	 * part of a message generated by the module itself.
	 */
	switch (bt_st_rx) {
	/*
	 * Wait for connection from master.
	 *
	 * Following message gets generated when remote endpoint connects:
 	 * <LF>CONNECT<SPACE><SPACE>'xxxx-xx-xxxxxx'<LF>
	 *
	 * And following one when it disconnects:
 	 * <LF>DISCONNECT<SPACE><SPACE>'xxxx-xx-xxxxxx'<LF>
	 */
	case BT_ST_RX_MSG_SOF1:
		/* Wait for SOF - <LF> */
		if (ch == '\n') {
			/* Wait for 1st character of the message. */
			bt_st_rx = BT_ST_RX_MSG_SOF2;
		}

		break;

	case BT_ST_RX_MSG_SOF2:
		/* Accept only 'CONNECT' and 'DISCONNECT' messages. */
		if (ch != 'C' &&  ch != 'D') {
			bt_st_rx = BT_ST_RX_MSG_SOF1;

			break;
		}

		/* Initialize message buffer. */
		memset(msg, 0, sizeof (msg));

		/* And store the 1st received character. */
		msg[0] = ch;

		bt_st_rx = BT_ST_RX_MSG_PAYLOAD;

		break;

	case BT_ST_RX_MSG_PAYLOAD:
		/* Keep receiving a message until EOF is received. */
		if (ch != '\n') {
			size_t l = strlen(msg);

			/* If buffer is full, discard received data. */
			if (l < sizeof (msg) - 1) {
				msg[l] = ch;
			}

			break;
		}

		/*
		 * Message complete, process it.
		 * 'connect' and 'disconnect' messages are
		 * currently recognized.
		 */
		if (strncmp(msg, BT_MSG_CONNECT, sizeof (BT_MSG_CONNECT) - 1)
		    == 0) {
			/* 'connect' message */

			/*
			 * Set the flag indicating that the connection
			 * has been established.
			 */
			bt_paired = TRUE;

			/*
			 * Determine who established the connection -
			 * either master terminal or GPS module.
			 */
			bt_paired_with_gps = strncmp(msg +
			    sizeof (BT_MSG_CONNECT) - 1,
			    BT_GPS_MAC, sizeof (BT_GPS_MAC) - 1) == 0;
		} else if (strncmp(msg, BT_MSG_DISCONNECT,
		    sizeof (BT_MSG_DISCONNECT) - 1) == 0) {
			/* 'disconnect' message */

			/*
			 * Clear the flag indicating that the connection
			 * has been established.
			 */
			bt_paired = FALSE;
		}

		/* Wait for another message. */
		bt_st_rx = BT_ST_RX_MSG_SOF1;

		break;
	} /* switch */
}

/*
 * Receive character directly from BT module.
 * Do not block if receive buffer is empty, return EAGAIN in that case.
 * If there is a character in receive buffer, get it and return 0.
 */
static int
bt_getchar_raw(unsigned char *ch)
{
	unsigned char dummy;

	/* There is no point to query UART if module is suspended. */
	if (bt_is_suspended) {
		return EAGAIN;
	}

	/* handle receive errors */
	if (U2STA & 0x000E) {
		/* dummy read to clear FERR/PERR */
		dummy = U2RXREG;
		/* clear OERR to keep receiving */
		U2STAbits.OERR = 0;
	}

	if (!U2STAbits.URXDA)
		return EAGAIN;

	/* get data from UART RX FIFO */
	*ch = U2RXREG;

	/*
	 * Let receive service process messages
	 * generated by the module itself.
	 */
	bt_rx_svc(*ch);

	return 0;
}

/* global functions */
/*
 * Initialize Bluetooth BTM-112 module.
 *  - connect power (active LOW)
 *  - deactivate RESET signal (active HIGH)
 *  - initialize communication channel - module connected to UART2
 */
int
bt_init(void)
{
	/* connect power to BT module (PB14) - active LOW */
	LATBCLR = 0x4000;
	TRISBCLR = 0x4000;

	/* deactivate  RESET signal (PB15) - active HIGH */
	LATBCLR = 0x8000;
	TRISBCLR = 0x8000;

	/*
	 * initialize UART2 used for communication with Bluetooth module
	 *  - baudrate: 115200 (NOTE: factory default is 19200)
	 *  - 8 data bits, 1 stop bit
	 *  - continue to operate in IDLE mode
	 *  - IrDA mode disabled
	 *  - HW flow control turned off
	 *  - Wake up from SLEEP on start bit disabled
	 *  - loopback mode disabled
	 *  - autobaud mode disabled
	 *  - standard speed mode - 16x baud clock enabled
	 */
	U2BRG = (SYS_FREQ / 16 / 115200 - 1);
	U2MODE = UART_EN;

	U2STA = (UART_RX_ENABLE | UART_TX_ENABLE);

	/* BT module not connected. */
	bt_paired = FALSE;

	/* BT module not connected with GPS */
	bt_paired_with_gps = FALSE;

	/* Let receive state machine wait for a connection from master. */
	bt_st_rx = BT_ST_RX_MSG_SOF1;

	/* Module is up and running. */
	bt_is_suspended = FALSE;

	return 0;
}

/*
 * Suspend Bluetooth module.
 *  - close communication channel
 *  - disconnect power (active LOW)
 *  - deactivate RESET signal (active HIGH)
 */
int
bt_suspend(void)
{
	/*
	 * Turn off UART communication channel. Configure UART pins as
	 * digital inputs.
	 */
	TRISFSET = (1 << 4) | (1 << 5);
	U2STA = 0;
	U2MODE = UART_DIS;

	/*
	 * disconnect RESET signal (PB15)
	 * - configure pin as an input
	 */
	TRISBSET = 0x8000;

	/*
	 * disconnect power from BT module (PB14)
	 * - configure pin as an input
	 */
	TRISBSET = 0x4000;

	bt_is_suspended = TRUE;

	return 0;
}

/*
 * Send character to BT module.
 * Discard characters if we are not connected to the master,
 * so that we inadvertently do not modify module configuration.
 * Do not block if there is no space in transmit buffer, return EAGAIN
 * in that case. If character can be put into transmit buffer return 0.
 */
int
bt_putchar(unsigned char ch, BOOL block)
{
	/* There is no point to touch the UART if module is suspended. */
	if (bt_is_suspended) {
		return EAGAIN;
	}

	/* Not connected to the master, discard character. */
	if (!bt_is_paired()) {
		return 0;
	}

	/*
	 * If operating in blocking mode, spin until transmitter
	 * is ready, then send the character.
	 */
	if (!U2STAbits.TRMT) {
		if (block) {
			while (!U2STAbits.TRMT);
		} else {
			return EAGAIN;
		}
	}

	U2TXREG = ch;

	return 0;
}

/*
 * Receive character from GPS connected via BT.
 * Do not block if receive buffer is empty, return EAGAIN in that case.
 * If there is a character in receive buffer, get it and return 0.
 */
int
bt_getchar_gps(unsigned char *ch)
{
	if (bt_paired_with_gps) {
		return bt_getchar_raw(ch);
	}

	return EAGAIN;
}

/*
 * Receive character from 'master' remote terminal connected via BT.
 * Do not block if receive buffer is empty, return EAGAIN in that case.
 * If there is a character in receive buffer, get it and return 0.
 */
int
bt_getchar_master(unsigned char *ch)
{
	if (!bt_paired_with_gps) {
		return bt_getchar_raw(ch);
	}

	return EAGAIN;
}

/*
 * Return TRUE if BT module is paired with remote BT end-point;
 * FALSE otherwise.
 */
BOOL
bt_is_paired(void)
{
	return (bt_paired && !bt_is_suspended);
}


/*
 * Return TRUE if BT module is paired with GPS module;
 * FALSE otherwise.
 */
BOOL
bt_is_paired_with_gps(void)
{
	return (bt_is_paired() && bt_paired_with_gps);
}

/*
 * Return TRUE if BT module is paired with master module;
 * FALSE otherwise.
 */
BOOL
bt_is_paired_with_master(void)
{
	return (bt_is_paired() && !bt_paired_with_gps);
}
