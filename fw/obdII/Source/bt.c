#include "GenericTypeDefs.h"
#include "HardwareProfile/HardwareProfile.h"
#include "peripheral/uart.h"
#include "xc.h"
#include "bt.h"
#include "mon.h"
#include "master_comm.h"
#include <stdlib.h>
#include <stdio.h>

/*
static const char hex2ascii_tbl[16] = {'0', '1', '2', '3', '4', '5', '6',
    '7', '8', '9', 'A', 'B', 'C', 'D', 'E', 'F'};

static int hex2ascii(unsigned char b)
{
	mon_putchar(hex2ascii_tbl[(b >> 4) & 0x0f]);
	mon_putchar(hex2ascii_tbl[b & 0x0f]);
}
*/

/* state machine states */
#define BT_ST_IDLE	0	/* machine is IDLE */
#define BT_ST_TX	1	/* transmit character */

/* local variables */
/* SW transmit buffer - just one character for now */
static unsigned char bt_tx_buffer[1];
/* state of main state machine */
static int bt_st;
/* flag that BT module is paired */
static BOOL bt_paired = FALSE;

/*
 * Initialize Bluetooth BTM-112 module.
 *  - connect power (active LOW)
 *  - deactivate RESET signal (active HIGH)
 *  - initialize communication channel - module connected to UART2
 */
int
bt_init(void)
{
	/* connect power to BT module (PB14) - active LOW */
	LATBCLR = 0x4000;
	TRISBCLR = 0x4000;

	/* deactivate  RESET signal (PB15) - active HIGH */
	LATBCLR = 0x8000;
	TRISBCLR = 0x8000;

	/*
         * initialize UART2 used for communication with Bluetooth module
	 *  - baudrate: 115200 (NOTE: factory default is 19200)
	 *  - 8 data bits, 1 stop bit
	 *  - continue to operate in IDLE mode
	 *  - IrDA mode disabled
	 *  - HW flow control turned off
	 *  - Wake up from SLEEP on start bit disabled
	 *  - loopback mode disabled
	 *  - autobaud mode disabled
	 *  - standard speed mode - 16x baud clock enabled
	 */
	U2BRG = (SYS_FREQ / 16 / 115200 - 1);
//	U2MODE = UART_EN | UART_EN_WAKE;
	U2MODE = UART_EN;

	U2STA = (UART_RX_ENABLE | UART_TX_ENABLE);

	/* State machine is idle */
	bt_st = BT_ST_IDLE;

	return BT_OK;
}

/*
 * Suspend Bluetooth module.
 *  - close communication channel
 *  - disconnect power (active LOW)
 *  - deactivate RESET signal (active HIGH)
 */
int
bt_suspend(void)
{
	/*
	 * Turn off UART communication channel. Configure UART pins as
	 * digital inputs.
	 */
	TRISFSET = (1 << 4) | (1 << 5);
	U2STA = 0;
	U2MODE = UART_DIS;

	/*
	 * disconnect RESET signal (PB15)
	 * - configure pin as an input
	 */
	TRISBSET = 0x8000;

	/*
	 * disconnect power from BT module (PB14)
	 * - configure pin as an input
	 */
	TRISBSET = 0x4000;


	return BT_OK;
}

/*
 * Send character to BT module.
 * Do not block if there is no space in transmit buffer, return BT_TX_FULL
 * in that case. If character can be put into transmit buffer return BT_OK.
 */
int
bt_putchar(unsigned char ch)
{
	/* busy with sending previous character, return */
	if (bt_st != BT_ST_IDLE)
		return BT_TX_FULL;

	/* If there is no space in HW TX buffer, postpone transmission */
	if (U2STAbits.UTXBF) {
		bt_tx_buffer[0] = ch;
		bt_st = BT_ST_TX;

		return BT_OK;
	}

	/* There is a space in HW TX buffer */
	U2TXREG = ch;
	return BT_OK;
}

/*
 * Receive character from BT module.
 * Do not block if receive buffer is empty, return BT_RX_EMPTY in that case.
 * If there is a character in receive buffer, get it and return BT_OK.
 * Process following messages generated by BT module:
 *  "CONNECT 'address'" - connection established
 *  "DISCONNECT 'address'" - connection closed
 */
int
bt_getchar(unsigned char *ch)
{
	unsigned char dummy;
	static BOOL rx_bt_message = FALSE;

	/* handle receive errors */
	if (U2STA & 0x000E) {
		/* dummy read to clear FERR/PERR */
		dummy = U2RXREG;
		/* clear OERR to keep receiving */
		U2STAbits.OERR = 0;
	}

	if (!U2STAbits.URXDA)
		return BT_RX_EMPTY;

	/* get data from UART RX FIFO */
	*ch = U2RXREG;

	/*
	 * handle control messages generated by BT module - they are enclosed
	 * within double quotes.
	 */
	if (*ch == '\x0a') {
		rx_bt_message = TRUE;
	} else if (rx_bt_message) {
		if (*ch == 'C') {
			bt_paired = TRUE;
		} else if (*ch == 'D') {
			bt_paired = FALSE;
		}

		rx_bt_message = FALSE;
	}

	return BT_OK;
}

/*
 * Return TRUE if BT module is paired with master, otherwise return FALSE
 */
BOOL
bt_is_paired(void)
{
	return (bt_paired);
}

/*
 * Service function handling all BT events.
 */
int
bt_service(void)
{
//	unsigned char ch;

	/* Characters received, process them */
//	while (bt_getchar(&ch) == BT_OK) {
//		mon_putchar('<');
//		hex2ascii(ch);
		/* Do not check for a return value, assume there is always
		 * a space in TX buffer
		 */
//		mcom_rx_cb(ch);
//		if (mon_putchar(ch) != MON_OK)
//			LATBCLR = 1 << 12;
//		mon_putchar('>');
//	}

	/* Handle transmit buffer */
	switch (bt_st) {
	case BT_ST_IDLE:
		break;

	/*
	 * Wait for a space in HW TX buffer, then transmit character
	 * waiting in SW buffer
	 */
	case BT_ST_TX:
		/* There is no space in transmit buffer, try later */
		if (U2STAbits.UTXBF)
			break;

		U2TXREG = bt_tx_buffer[0];
		bt_st = BT_ST_IDLE;
		break;

	/* Shouldn't happen, but... */
	default:
		break;
	}


	return BT_OK;
}

