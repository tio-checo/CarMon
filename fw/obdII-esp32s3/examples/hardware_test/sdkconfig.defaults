## fw/obdII-esp32s3/examples/hardware_test/sdkconfig.defaults
```kconfig
CONFIG_IDF_TARGET="esp32s3"
CONFIG_ESPTOOLPY_FLASHSIZE_16MB=y
CONFIG_ESPTOOLPY_FLASHMODE_DIO=y
CONFIG_ESPTOOLPY_FLASHFREQ_40M=y
CONFIG_ESP_CONSOLE_USB_SERIAL_JTAG=y
CONFIG_ESP_CONSOLE_SECONDARY_NONE=y
CONFIG_ESPTOOLPY_MONITOR_BAUD=115200
CONFIG_SPIRAM=y
CONFIG_SPIRAM_MODE_OCT=y
CONFIG_SPIRAM_TYPE_AUTO=y
CONFIG_SPIRAM_SPEED_40M=y
CONFIG_SPIRAM_BOOT_INIT=y
# CONFIG_SPIRAM_MEMTEST is not set
CONFIG_SPIRAM_USE_CAPS_ALLOC=y
CONFIG_SPIRAM_IGNORE_NOTFOUND=y
CONFIG_ESP_SYSTEM_EVENT_TASK_STACK_SIZE=4096
CONFIG_MBEDTLS_CERTIFICATE_BUNDLE=y
CONFIG_MBEDTLS_HAVE_TIME_DATE=y
CONFIG_ESP_MAIN_TASK_STACK_SIZE=8192
```

## fw/obdII-esp32s3/main/Kconfig.projbuild
```kconfig
menu "CarMon network"

    config CARMON_WIFI_SSID
        string "Wi-Fi station SSID"
        default "UPC5254179"
        help
            Router or hotspot to connect to automatically after each reset.
            The SSID must contain 1 to 32 bytes.

    config CARMON_WIFI_PASSWORD
        string "Wi-Fi station password"
        default ""
        help
            WPA2/WPA3 passphrase containing 8 to 63 bytes. An empty or invalid
            value leaves networking stopped and prints a configuration error.
            This value is stored in sdkconfig and compiled into the firmware.
            The Wi-Fi driver does not save another copy in NVS.

    config CARMON_TCP_PORT
        int "TCP server port"
        range 1024 65535
        default 3333
        help
            CarMon protocol connection for one client at a time.

endmenu
```
